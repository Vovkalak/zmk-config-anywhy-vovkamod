## boards/shields/anywhy_vovka/Kconfig.defconfig
```kconfig
if SHIELD_ANYWHY_VOVKA_LEFT

config ZMK_KEYBOARD_NAME
    default "anywhy-vovka"

config ZMK_SPLIT_ROLE_CENTRAL
    default y

endif # SHIELD_ANYWHY_VOVKA_LEFT

if SHIELD_ANYWHY_VOVKA_LEFT || SHIELD_ANYWHY_VOVKA_RIGHT

config ZMK_SPLIT
    default y

endif # SHIELD_ANYWHY_VOVKA_LEFT || SHIELD_ANYWHY_VOVKA_RIGHT
```

## boards/shields/anywhy_vovka/Kconfig.shield
```kconfig
config SHIELD_ANYWHY_VOVKA_LEFT
    def_bool $(shields_list_contains,anywhy_vovka_left)

config SHIELD_ANYWHY_VOVKA_RIGHT
    def_bool $(shields_list_contains,anywhy_vovka_right)
```
